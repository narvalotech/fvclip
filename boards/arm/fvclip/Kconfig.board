## boards/arm/fvclip/Kconfig.defconfig
```kconfig
if BOARD_FVCLIP

config BOARD
	default "fvclip"

config USB_CDC_ACM_LOG_LEVEL
	# Get rid of build warning.
	# The value would still be forced to 0
	default 0

endif # BOARD_FVCLIP
```

## boards/arm/fvclip/fvclip_defconfig
```kconfig
# SPDX-License-Identifier: Apache-2.0

CONFIG_SOC_SERIES_NRF52X=y
CONFIG_SOC_NRF52840_QIAA=y
CONFIG_BOARD_FVCLIP=y

# Enable MPU
CONFIG_ARM_MPU=y

# Enable hardware stack protection
CONFIG_HW_STACK_PROTECTION=y

# enable GPIO
CONFIG_GPIO=y

# enable uart driver
CONFIG_SERIAL=y

# enable console on RTT
CONFIG_CONSOLE=y
CONFIG_USE_SEGGER_RTT=y
CONFIG_RTT_CONSOLE=y
CONFIG_UART_CONSOLE=n

CONFIG_PINCTRL=y

# This board doesn't have a crystal
CONFIG_CLOCK_CONTROL_NRF_K32SRC_RC=y
```
